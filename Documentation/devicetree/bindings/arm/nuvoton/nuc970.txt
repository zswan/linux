## Documentation/devicetree/bindings/arm/nuvoton/nuc970.txt
```
Nuvoton NUC970 SoC platform Device Tree Bindings
------------------------------------------

Boards with the NUC970 SoC shall have the following properties:

Root node required properties:
- compatible: Should be "syscon" or "nuvoton,nuc970-gcr"

GCR register required properties:
- compatible: Should be "nuvoton,nuc970-gcr"
- reg: Should contain registers location and length
```

## Documentation/devicetree/bindings/clock/nuvoton,nuc970-clk.txt
```
NUC970 Clock Controller

Clock required properties:
- compatible: Should be "nuvoton,nuc970-clk"
- reg: Should contain registers location and length

Examples:

clks: clk@b0000200 {
	compatible = "nuvoton,nuc970-clk";
	reg = <0xb0000200 0x200>;
	#clock-cells = <1>;
};
```

## Documentation/devicetree/bindings/interrupt-controller/nuvoton,nuc900-aic.txt
```
NUC900 interrupt Controller

Interrupt-controller required properties
- compatible: Should be "nuvoton,nuc900-aic"
- reg: Should contain registers location and length
- interrupt-cells: set to 1

Examples:

aic: interrupt-controller@b8002000 {
	compatible = "nuvoton,nuc900-aic";
	interrupt-controller;
	#interrupt-cells = <1>;
	reg = <0xb8002000 0x1000>;
};
```

## Documentation/devicetree/bindings/reset/nuvoton,nuc900-reset.txt
```
. Nuvoton NUC900 series, reset controller binding.

Required properties:
- compatible : Should be "nuvoton,nuc900-reset"
- syscon : Reference to gcr controller.

Example:

reset {
	compatible = "nuvoton,nuc900-reset";
	syscon = <&gcr>;
};
```

## Documentation/devicetree/bindings/serial/nuc970-uart.txt
```
NUC970 UART Controller

Uart required properties:
- compatible: Should be "nuvoton,nuc970-uart"
- reg: Should contain registers location and length

Examples:

aliases {
	serial0 = &uart0;
};

uart0: serial@b8000000 {
	compatible = "nuvoton,nuc970-uart";
	reg = <0xb8000000 0x1000>;
	interrupts = <36>;
	clocks = <&clks UART0_GATE>,
		 <&clks UART0_ECLK_GATE>;
	clock-names = "uart0", "uart0_eclk";
	clock-frequency = <12000000>;
	status = "disabled";
};
```

## Documentation/devicetree/bindings/soc/nuvoton/nuvoton,nuc900-soc.txt
```
. Nuvoton NUC900 series, Soc specific driver binding.

Required properties:
- compatible : Should be "nuvoton,nuc900-soc"
- syscon : Reference to gcr controller.

Example:

reset {
	compatible = "nuvoton,nuc900-soc";
	syscon = <&gcr>;
};
```

## Documentation/devicetree/bindings/timer/nuvoton,nuc970-tmr.txt
```
. Nuvoton NUC900 series, NUC970 SoC timer

The NUC900 family has several general-purpose 32 bits timers.

Required properties:
- compatible : Should be "nuvoton,nuc970-tmr"
- reg : Address and length of the register set
- clocks : Reference on the timer input clock
- interrupts : Reference to the timer interrupt

Example:

tmr@0xb8001000 {
	compatible = "nuvoton,nuc970-tmr";
	reg = <0xb8001000 0x1000>;
	interrupts = <16>;
	clocks = <&clks TIMER0_GATE>,
	<&clks TIMER1_GATE>;
	clock-names = "timer0", "timer1";
};
```

## arch/arm/configs/nuc970_defconfig
```kconfig
# CONFIG_LOCALVERSION_AUTO is not set
CONFIG_SYSVIPC=y
# CONFIG_CROSS_MEMORY_ATTACH is not set
CONFIG_NO_HZ=y
CONFIG_HIGH_RES_TIMERS=y
CONFIG_BSD_PROCESS_ACCT=y
CONFIG_BSD_PROCESS_ACCT_V3=y
CONFIG_CGROUPS=y
CONFIG_CGROUP_SCHED=y
CONFIG_RT_GROUP_SCHED=y
CONFIG_CGROUP_FREEZER=y
CONFIG_CPUSETS=y
CONFIG_CGROUP_DEVICE=y
CONFIG_CGROUP_CPUACCT=y
CONFIG_CGROUP_PERF=y
CONFIG_BLK_DEV_INITRD=y
CONFIG_INITRAMFS_SOURCE="../rootfs"
CONFIG_PERF_EVENTS=y
# CONFIG_COMPAT_BRK is not set
CONFIG_MODULES=y
CONFIG_MODULE_UNLOAD=y
CONFIG_ARCH_W90X900=y
CONFIG_SOC_NUC970=y
# CONFIG_MACH_W90P910EVB is not set
CONFIG_PREEMPT=y
CONFIG_AEABI=y
CONFIG_OABI_COMPAT=y
CONFIG_ARM_APPENDED_DTB=y
CONFIG_CMDLINE="root=/dev/ram0 console=ttyS0,115200n8 rdinit=/sbin/init mem=64M"
CONFIG_KEXEC=y
CONFIG_FPE_NWFPE=y
# CONFIG_CORE_DUMP_DEFAULT_ELF_HEADERS is not set
# CONFIG_SUSPEND is not set
CONFIG_UEVENT_HELPER_PATH="/sbin/hotplug"
CONFIG_DEVTMPFS=y
CONFIG_DEVTMPFS_MOUNT=y
# CONFIG_STANDALONE is not set
# CONFIG_PREVENT_FIRMWARE_BUILD is not set
# CONFIG_FIRMWARE_IN_KERNEL is not set
CONFIG_BLK_DEV_RAM=y
CONFIG_BLK_DEV_RAM_SIZE=16384
CONFIG_SCSI=y
# CONFIG_SCSI_PROC_FS is not set
CONFIG_BLK_DEV_SD=y
# CONFIG_SCSI_LOWLEVEL is not set
# CONFIG_INPUT_MOUSEDEV is not set
# CONFIG_INPUT_KEYBOARD is not set
# CONFIG_INPUT_MOUSE is not set
# CONFIG_SERIO is not set
CONFIG_VT_HW_CONSOLE_BINDING=y
# CONFIG_LEGACY_PTYS is not set
CONFIG_SERIAL_NUC970=y
CONFIG_SERIAL_NUC970_CONSOLE=y
# CONFIG_HW_RANDOM is not set
CONFIG_POWER_RESET=y
CONFIG_POWER_RESET_NUC900=y
# CONFIG_HWMON is not set
# CONFIG_HID is not set
# CONFIG_USB_SUPPORT is not set
# CONFIG_IOMMU_SUPPORT is not set
# CONFIG_DNOTIFY is not set
# CONFIG_INOTIFY_USER is not set
CONFIG_MSDOS_FS=y
CONFIG_VFAT_FS=y
CONFIG_TMPFS=y
CONFIG_TMPFS_POSIX_ACL=y
CONFIG_ROMFS_FS=y
CONFIG_NLS_CODEPAGE_437=y
CONFIG_NLS_ISO8859_1=y
CONFIG_MESSAGE_LOGLEVEL_DEFAULT=7
# CONFIG_ENABLE_WARN_DEPRECATED is not set
# CONFIG_ENABLE_MUST_CHECK is not set
CONFIG_DEBUG_FS=y
CONFIG_RCU_CPU_STALL_TIMEOUT=300
CONFIG_STRICT_DEVMEM=y
# CONFIG_ARM_UNWIND is not set
```

## arch/arm/mach-w90x900/Kconfig
```kconfig
if ARCH_W90X900

config CPU_W90P910
	bool
	help
	  Support for W90P910 of Nuvoton W90X900 CPUs.

config CPU_NUC950
	bool
	help
	  Support for NUCP950 of Nuvoton NUC900 CPUs.

config CPU_NUC960
	bool
	help
	  Support for NUCP960 of Nuvoton NUC900 CPUs.

config SOC_NUC970
	bool "Nuvoton NUC970 SoC support"
	select COMMON_CLK
	select GENERIC_IRQ_CHIP
	select HAVE_CLK_PREPARE
	select IRQ_DOMAIN
	select MULTI_IRQ_HANDLER
	select MFD_SYSCON
	select NUC900_TIMER
	select SOC_NUC900
	select USE_OF
	help
	  Support for NUC970 of Nuvoton NUC900 SoCs.
	  The NUC970 series runs up to 300 MHz, with 16 KB I-cache,
	  16 KB D-cache and MMU, 56KB embedded SRAM and 16 KB Internal
	  Boot ROM for booting from USB, NAND and SPI FLASH.
	  Detailed information please check the following link:
	  https://github.com/zswan/nuc900-document/blob/master/
	  NUC970_TechnicalReferenceManual_EN_Rev1.30.pdf

menu "W90P910 Machines"

config MACH_W90P910EVB
	bool "Nuvoton W90P910 Evaluation Board"
	default y
	select CPU_W90P910
	help
	   Say Y here if you are using the Nuvoton W90P910EVB

endmenu

menu "NUC950 Machines"

config MACH_W90P950EVB
	bool "Nuvoton NUC950 Evaluation Board"
	select CPU_NUC950
	help
	   Say Y here if you are using the Nuvoton NUC950EVB

endmenu

menu "NUC960 Machines"

config MACH_W90N960EVB
	bool "Nuvoton NUC960 Evaluation Board"
	select CPU_NUC960
	help
	   Say Y here if you are using the Nuvoton NUC960EVB

endmenu

endif
```

## drivers/soc/nuvoton/Kconfig
```kconfig
#
# ARM Versatile SoC drivers
#
config SOC_NUC900
	bool "SoC bus device for the nuvoton NUC900 platforms"
	depends on ARCH_W90X900
	select SOC_BUS
	help
	  Include support for the SoC bus on the NUC900 platforms
	  providing some sysfs information about the ASIC variant.
```
